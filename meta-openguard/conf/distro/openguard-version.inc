## meta-openguard/conf/distro/openguard.conf
```bitbake
DISTRO = "openguard"
DISTRO_NAME = "openguard"

include conf/distro/openguard-version.inc

DISTRO_RELEASE_VERSION = "${@distro_release_version(d)}"
DISTRO_ITERATION := "${@distro_iteration(d)}"
DISTRO_LOCALCOMMITS := "${@distro_localcommits(d)}"
DISTRO_LAYERHASH = "${@distro_layer_hashes(d)}"
DISTRO_LOCALCHANGES := "${@distro_localchanges(d)}"
DISTRO_LOCALCHANGESHASH := "${@distro_localchanges_hash(d)}"
DISTRO_VERSION := "${@distro_build_version(d)}"

#DISTRO_CODENAME = ""
MAINTAINER = "openguard"
TARGET_VENDOR = "-openguard"

#SDK_NAME = "${DISTRO}-${TCLIBC}-${SDK_ARCH}-${IMAGE_BASENAME}-${TUNE_PKGARCH}"
#SDK_VERSION := "${@'${DISTRO_VERSION}'.replace('+${DATE}','+snapshot')}"
#SDK_VERSION[vardepsexclude] = "DATE"
#SDK_VENDOR = "-openguard-sdk"
#SDKPATH = "/opt/${DISTRO}/${SDK_VERSION}"

OPENGUARD_DEFAULT_DISTRO_FEATURES = "ptest systemd pam"
OPENGUARD_DEFAULT_EXTRA_RDEPENDS = "packagegroup-core-boot"
OPENGUARD_DEFAULT_EXTRA_RRECOMMENDS = ""

OPENGUARD_DISTRO_FEATURES = "${DISTRO_FEATURES_DEFAULT} ${DISTRO_FEATURES_LIBC} ${OPENGUARD_DEFAULT_DISTRO_FEATURES}"
OPENGUARD_DISTRO_FEATURES_remove = "3g alsa bluetooth bluez5 gobject-introspection-data irda libc-nis libc-rcmd libc-sunrpc nfc nfs pcmcia pulseaudio sysvinit wifi x11 zeroconf"

DISTRO_FEATURES ?= "${OPENGUARD_DISTRO_FEATURES}"
DISTRO_FEATURES_BACKFILL_CONSIDERED_append = " bluez5 gobject-introspection-data pulseaudio sysvinit"
DISTRO_EXTRA_RDEPENDS += " ${OPENGUARD_DEFAULT_EXTRA_RDEPENDS}"
DISTRO_EXTRA_RRECOMMENDS += " ${OPENGUARD_DEFAULT_EXTRA_RRECOMMENDS}"

PREFERRED_PROVIDER_virtual/kernel ?= "linux-yocto"
PREFERRED_VERSION_linux-yocto ?= "4.19%"

VIRTUAL-RUNTIME_init_manager = "systemd"
VIRTUAL-RUNTIME_initscripts = "systemd-compat-units"

TCLIBCAPPEND = ""

PREMIRRORS ??= "\
cvs://.*/.*     https://pxccs-gitlab.dev.de.innominate.com/archive/openguard/ \n \
svn://.*/.*     https://pxccs-gitlab.dev.de.innominate.com/archive/openguard/ \n \
git://.*/.*     https://pxccs-gitlab.dev.de.innominate.com/archive/openguard/ \n \
gitsm://.*/.*   https://pxccs-gitlab.dev.de.innominate.com/archive/openguard/ \n \
hg://.*/.*      https://pxccs-gitlab.dev.de.innominate.com/archive/openguard/ \n \
bzr://.*/.*     https://pxccs-gitlab.dev.de.innominate.com/archive/openguard/ \n \
p4://.*/.*      https://pxccs-gitlab.dev.de.innominate.com/archive/openguard/ \n \
osc://.*/.*     https://pxccs-gitlab.dev.de.innominate.com/archive/openguard/ \n \
http://.*/.*    https://pxccs-gitlab.dev.de.innominate.com/archive/openguard/ \n \
https://.*/.*   https://pxccs-gitlab.dev.de.innominate.com/archive/openguard/ \n \
ftp://.*/.*     https://pxccs-gitlab.dev.de.innominate.com/archive/openguard/ \n \
npm://.*/?.*    https://pxccs-gitlab.dev.de.innominate.com/archive/openguard/ \n"

MIRRORS =+ "\
cvs://.*/.*     http://downloads.yoctoproject.org/mirror/sources/ \n \
svn://.*/.*     http://downloads.yoctoproject.org/mirror/sources/ \n \
git://.*/.*     http://downloads.yoctoproject.org/mirror/sources/ \n \
gitsm://.*/.*   http://downloads.yoctoproject.org/mirror/sources/ \n \
hg://.*/.*      http://downloads.yoctoproject.org/mirror/sources/ \n \
bzr://.*/.*     http://downloads.yoctoproject.org/mirror/sources/ \n \
p4://.*/.*      http://downloads.yoctoproject.org/mirror/sources/ \n \
osc://.*/.*     http://downloads.yoctoproject.org/mirror/sources/ \n \
http://.*/.*    http://downloads.yoctoproject.org/mirror/sources/ \n \
https://.*/.*   http://downloads.yoctoproject.org/mirror/sources/ \n \
ftp://.*/.*     http://downloads.yoctoproject.org/mirror/sources/ \n \
npm://.*/?.*    http://downloads.yoctoproject.org/mirror/sources/ \n"

SANITY_TESTED_DISTROS ?= "debian-9"

OELAYOUT_ABI = "12"

WARN_TO_ERROR_QA = "already-stripped compile-host-path install-host-path \
                    installed-vs-shipped ldflags pn-overrides rpaths staticdev \
                    useless-rpaths"
WARN_QA_remove = "${WARN_TO_ERROR_QA}"
ERROR_QA_append = " ${WARN_TO_ERROR_QA}"

#
# Auto archive sources
#
INHERIT += "archiver"
## Pack original sources and patches
## See http://www.yoctoproject.org/docs/current/ref-manual/ref-manual.html#var-ARCHIVER_MODE
ARCHIVER_MODE[src] ?= "original"
ARCHIVER_MODE[diff] ?= "1"
## Optional
## Currently only package really shipped to target are packed
## See http://www.yoctoproject.org/docs/current/ref-manual/ref-manual.html#var-COPYLEFT_RECIPE_TYPES
COPYLEFT_RECIPE_TYPES ?= 'target'
## See http://www.yoctoproject.org/docs/current/ref-manual/ref-manual.html#var-COPYLEFT_LICENSE_EXCLUDE
## COPYLEFT_LICENSE_EXCLUDE ?= "CLOSED"
## See http://www.yoctoproject.org/docs/current/ref-manual/ref-manual.html#var-COPYLEFT_LICENSE_INCLUDE
## COPYLEFT_LICENSE_INCLUDE ?= "GPL* LGPL* AGPL*"
## See http://www.yoctoproject.org/docs/current/ref-manual/ref-manual.html#var-COPYLEFT_PN_EXCLUDE
## COPYLEFT_PN_EXCLUDE ?= ""
## See http://www.yoctoproject.org/docs/current/ref-manual/ref-manual.html#var-COPYLEFT_PN_INCLUDE
## COPYLEFT_PN_INCLUDE ?= ""

#
# Deployment of license-texts
#
# This will deploy all used license-texts file to /usr/share/common-licenses
# in target image
LICENSE_CREATE_PACKAGE ?= "1"
COPY_LIC_DIRS ?= "1"
COPY_LIC_MANIFEST ?= "1"

require conf/distro/include/no-static-libs.inc

require conf/distro/include/security_flags.inc
```

## meta-openguard/conf/layer.conf
```bitbake
BBPATH =. "${LAYERDIR}:"

BBFILES += "${LAYERDIR}/recipes-*/*/*.bb \
            ${LAYERDIR}/recipes-*/*/*.bbappend"

BBFILE_COLLECTIONS += "openguard"
BBFILE_PATTERN_openguard = "^${LAYERDIR}/"
BBFILE_PRIORITY_openguard = "28"

LAYERVERSION_openguard = "1"
LAYERDEPENDS_openguard = "core"

LAYERSERIES_COMPAT_openguard = "thud"

# Remove perl dependency from meta-security layer. It is not needed for
# the recipes that OpenGuard uses from that layer.
LAYERDEPENDS_security_remove = "perl-layer"
```

## meta-openguard/conf/machine/cb-88f3720-ddr3-espressobin.conf
```bitbake
#@TYPE: Machine
#@NAME: Marvell ESPRESSOBin community board (little-endian)
#@SOC: ARMADA 3720
#@DESCRIPTION: Machine configuration for Marvel ESPRESSOBin community board (little-endian)

require conf/machine/include/armada37xx-base.inc

KERNEL_DEVICETREE = "marvell/armada-3720-espressobin.dtb"

KERNEL_IMAGETYPE = "Image"

IMAGE_FSTYPES += "wic"
WKS_FILES = "cb-88f3720-ddr3-espressobin.wks"
IMAGE_BOOT_FILES = "Image-cb-88f3720-ddr3-espressobin.bin armada-3720-espressobin.dtb"

MACHINE_EXTRA_RRECOMMENDS += "kernel-modules"
```

## meta-openguard/conf/machine/include/armada37xx-base.inc
```bitbake
# Provides the Marvell Armada 37xx common settings

require conf/machine/include/arm/arch-arm64.inc

MACHINE_ENDIANNESS ?= "le"

DEFAULTTUNE_armada37xx ?= "${@bb.utils.contains("MACHINE_ENDIANNESS", "le", "aarch64", "aarch64_be", d)}"

MACHINEOVERRIDES =. "armada37xx:"

IMAGE_FSTYPES += "tar.bz2"

SERIAL_CONSOLES = "115200;ttyMV0"

KERNEL_IMAGETYPE = "Image"

MACHINE_FEATURES = "ext2 nfs pci usbgadget usbhost vfat"
```

## meta-openguard/conf/machine/mguard3.conf
```bitbake
#@TYPE: Machine
#@NAME: mGuard3 board (little-endian)
#@SOC: ARMADA 3720
#@DESCRIPTION: Machine configuration for mGuard3

require conf/machine/include/armada37xx-base.inc

KERNEL_DEVICETREE = "marvell/armada-3720-mguard3.dtb"

KERNEL_IMAGETYPE = "Image"

IMAGE_FSTYPES += "wic"
WKS_FILES = "mguard3.wks"
IMAGE_BOOT_FILES = "Image-mguard3.bin armada-3720-mguard3.dtb"
IMAGE_BOOT_ROOTFS_TYPE = "squashfs"

MACHINE_EXTRA_RRECOMMENDS += "kernel-modules"
MACHINE_ESSENTIAL_EXTRA_RRECOMMENDS += " \
  kernel-module-rtc-pcf2123 \
  kernel-module-tpm \
  kernel-module-tpm-tis-core \
  kernel-module-tpm-tis-spi \
  "

## Bootloader Settings
PREFERRED_PROVIDER_virtual/bootloader ?= "u-boot-marvell"
PREFERRED_PROVIDER_u-boot ?= "u-boot-marvell"

UBOOT_MACHINE = "mvebu_mguard3-88f3720_defconfig"
UBOOT_DEVICE_TREE = "armada-3720-mguard3"
ARM_TRUSTED_FIRMWARE_PLATFORM = "a3700"
```

## meta-openguard/recipes-bsp/openguard-u-boot-preproduction/openguard-u-boot-preproduction/mvebu_mguard3-88f3720_defconfig
```kconfig
# CONFIG_CMD_FLASH is not set
# CONFIG_CMD_FPGA is not set
# CONFIG_CMD_IMLS is not set
# CONFIG_CMD_SAVEENV is not set
# CONFIG_DISPLAY_BOARDINFO is not set
# CONFIG_NET_RANDOM_ETHADDR is not set
# CONFIG_SPL_SERIAL_PRESENT is not set
# CONFIG_SYS_MALLOC_CLEAR_ON_INIT is not set
CONFIG_AHCI_MVEBU=y
CONFIG_AHCI=y
CONFIG_ARCH_EARLY_INIT_R=y
CONFIG_ARCH_MVEBU=y
CONFIG_ARM=y
CONFIG_ARMADA_3700=y
CONFIG_BLOCK_CACHE=y
CONFIG_BOARD_EARLY_INIT_F=y
CONFIG_CMD_CACHE=y
CONFIG_CMD_DHCP=y
CONFIG_CMD_EXT4_WRITE=y
CONFIG_CMD_EXT4=y
CONFIG_CMD_FAT=y
CONFIG_CMD_FS_GENERIC=y
CONFIG_CMD_GPIO=y
CONFIG_CMD_GPT=y
CONFIG_CMD_I2C=y
CONFIG_CMD_MACRND=y
CONFIG_CMD_MEMTEST=y
CONFIG_CMD_MII=y
CONFIG_CMD_MMC=y
CONFIG_CMD_MODE_BTN=y
CONFIG_CMD_MVEBU_BUBT=y
CONFIG_CMD_MVEBU_SDFLASH=y
CONFIG_CMD_PART=y
CONFIG_CMD_PING=y
CONFIG_CMD_SETEXPR=y
CONFIG_CMD_SF=y
CONFIG_CMD_SPI=y
CONFIG_CMD_TIME=y
CONFIG_CMD_USB=y
CONFIG_CONSOLE_MUX=y
CONFIG_DEBUG_MVEBU_A3700_UART=y
CONFIG_DEBUG_UART_ANNOUNCE=y
CONFIG_DEBUG_UART_BASE=0xd0012000
CONFIG_DEBUG_UART_CLOCK=25804800
CONFIG_DEBUG_UART_SHIFT=2
CONFIG_DEBUG_UART=y
CONFIG_DEFAULT_DEVICE_TREE="armada-3720-mguard3"
CONFIG_DISTRO_DEFAULT=y
CONFIG_DM_GPIO=y
CONFIG_DM_I2C=y
CONFIG_DM_MMC=y
CONFIG_DM_PCI=y
CONFIG_DM_REGULATOR_FIXED=y
CONFIG_DM_REGULATOR_GPIO=y
CONFIG_DM_SCSI=y
CONFIG_DM_USB=y
CONFIG_EFI_PARTITION=y
CONFIG_FIT_SIGNATURE=y
CONFIG_FIT=y
CONFIG_HUSH_PARSER=y
CONFIG_HW_WATCHDOG=y
CONFIG_ISO_PARTITION=y
CONFIG_MAC_PARTITION=y
CONFIG_MISC=y
CONFIG_MMC_SDHCI_SDMA=y
CONFIG_MMC_SDHCI_XENON=y
CONFIG_MMC_SDHCI=y
CONFIG_MV88E6352_SWITCH=y
CONFIG_MVEBU_A3700_SPI=y
CONFIG_MVEBU_A3700_UART=y
CONFIG_MVEBU_COMPHY_SUPPORT=y
CONFIG_MVEBU_SCSI=y
CONFIG_MVEBU_SYS_INFO=y
CONFIG_MVNETA=y
CONFIG_NET=y
CONFIG_NETDEVICES=y
CONFIG_OF_BOARD_SETUP=y
CONFIG_OF_LIBFDT=y
CONFIG_PCF8575_GPIO=y
CONFIG_PCI=y
CONFIG_PCIE_AARDVARK=y
CONFIG_PHY_GIGE=y
CONFIG_PINCTRL_ARMADA_37XX=y
CONFIG_PINCTRL=y
CONFIG_SCSI_AHCI=y
CONFIG_SHA1=y
CONFIG_SHA256=y
CONFIG_SPI_FLASH_MACRONIX=y
CONFIG_SPI_FLASH_SPANSION=y
CONFIG_SPI_FLASH_STMICRO=y
CONFIG_SPI_FLASH_WINBOND=y
CONFIG_SPI_FLASH=y
CONFIG_SYS_CONSOLE_INFO_QUIET=y
CONFIG_SYS_MALLOC_F_LEN=0x2000
CONFIG_SYS_PROMPT="u-boot>> "
CONFIG_SYS_TEXT_BASE=0x00000000
CONFIG_TARGET_MVEBU_ARMADA_37XX=y
CONFIG_USB_EHCI_HCD=y
CONFIG_USB_STORAGE=y
CONFIG_USB_XHCI_HCD=y
CONFIG_USB=y
CONFIG_USE_BOOTCOMMAND=y
```
